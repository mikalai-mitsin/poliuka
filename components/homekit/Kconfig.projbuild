## components/homekit/Kconfig.projbuild
```kconfig
menu "Apple HomeKit"

    config HOMEKIT_SETUP_CODE
        string "Setup code"
        default "111-22-333"
        help
            Setup code of the format xxx-xx-xxx where each x is a number

    config HOMEKIT_SETUP_ID
        string "Setup ID"
        default "ES32"
        help
            Setup ID, which will be a 4 character long alpha numeric string (with capital alphabets)
endmenu
```

## main/Kconfig.projbuild
```kconfig
menu "UNIT"
    config UNIT_SOIL_MOISTURE_PIN
        int "Soil moisture sensor pin"
        default 0

    config UNIT_SOIL_MOISTURE_WATER_VALUE
        int "Soil moisture sensor watter value"
        default 2260

    config UNIT_SOIL_MOISTURE_AIR_VALUE
        int "Soil moisture sensor air value"
        default 4095

    config UNIT_DRY_LEVEL
        int "Soil moisture sensor dry level"
        default 60

    config UNIT_VALVE_PIN
        int "Soil valve pin"
        default 3

    config UNIT_PUMP_PIN
        int "Watter pump pin"
        default 2
endmenu
```
